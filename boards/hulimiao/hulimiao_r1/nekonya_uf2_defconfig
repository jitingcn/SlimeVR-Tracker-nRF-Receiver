## boards/hulimiao/hulimiao_r1/nekonya_uf2_defconfig
```kconfig
# Copyright (c) 2024 Nordic Semiconductor ASA
# SPDX-License-Identifier: Apache-2.0

CONFIG_ARM_MPU=y
CONFIG_HW_STACK_PROTECTION=y
CONFIG_GPIO=y

CONFIG_USB_DEVICE_MANUFACTURER="nekonya"
CONFIG_USB_DEVICE_PRODUCT="SlimeNRF Receiver NEKONYA"

CONFIG_USE_SEGGER_RTT=y
CONFIG_RTT_CONSOLE=y
CONFIG_LOG_BACKEND_RTT=y

CONFIG_MPSL=y
CONFIG_MPSL_FEM=y
CONFIG_MPSL_FEM_SIMPLE_GPIO=y
CONFIG_MPSL_FEM_GENERIC_TWO_CTRL_PINS_SUPPORT=y

#generate for adafruit uf2 bootloader flashing
CONFIG_BUILD_OUTPUT_UF2=y
CONFIG_BUILD_OUTPUT_UF2_FAMILY_ID="0x621e937a"
CONFIG_FLASH_LOAD_OFFSET=0x1000
CONFIG_RADIO_TX_POWER=30
```
