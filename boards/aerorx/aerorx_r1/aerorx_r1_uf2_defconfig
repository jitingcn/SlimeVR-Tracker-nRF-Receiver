## boards/aerorx/aerorx_r1/aerorx_r1_uf2_defconfig
```kconfig
# Copyright (c) 2024 Nordic Semiconductor ASA
# SPDX-License-Identifier: Apache-2.0

CONFIG_ARM_MPU=y
CONFIG_HW_STACK_PROTECTION=y
CONFIG_GPIO=y

CONFIG_SLIMEVR_USB_DEVICE_MANUFACTURER="AeroRX"
CONFIG_SLIMEVR_USB_DEVICE_PRODUCT="SlimeNRF Receiver AeroRX R1"

CONFIG_USE_SEGGER_RTT=y
CONFIG_RTT_CONSOLE=y
CONFIG_LOG_BACKEND_RTT=y

CONFIG_MPSL=y
CONFIG_MPSL_FEM=y
CONFIG_MPSL_FEM_SIMPLE_GPIO=y

#generate for adafruit uf2 bootloader flashing
CONFIG_BUILD_OUTPUT_UF2=y
CONFIG_RADIO_TX_POWER=30
```

## boards/dawnoriginal/dawnrx_2/Kconfig.dawnrx_2_uf2
```kconfig
# Copyright (c) 2024 Nordic Semiconductor ASA
# SPDX-License-Identifier: Apache-2.0

config BOARD_DAWNRX_2_UF2
	select SOC_NRF52833_QDAA

if BOARD_DAWNRX_2_UF2

config BOARD_SERIAL_BACKEND_CDC_ACM
	bool "USB CDC"
	default y

config BOARD_ENABLE_FEM
	bool "FEM enabled"
	default y
	select MPSL_FEM_GENERIC_TWO_CTRL_PINS_SUPPORT
	help
	  Enable the SKY66112-11 front-end module.

endif # BOARD_DAWNRX_2_UF2
```

## boards/dawnoriginal/dawnrx_2/board.yml
```yaml
# Copyright (c) 2024 Nordic Semiconductor ASA
# SPDX-License-Identifier: Apache-2.0

board:
  name: dawnrx_2_uf2
  full_name: Dawn Tracker nRF Receiver 2
  vendor: dawnoriginal
  socs:
    - name: nrf52833
```

## boards/dawnoriginal/dawnrx_2/dawnrx_2_uf2_defconfig
```kconfig
# Copyright (c) 2024 Nordic Semiconductor ASA
# SPDX-License-Identifier: Apache-2.0

CONFIG_ARM_MPU=y
CONFIG_HW_STACK_PROTECTION=y
CONFIG_GPIO=y

CONFIG_SLIMEVR_USB_DEVICE_MANUFACTURER="Dawnoriginal"
CONFIG_SLIMEVR_USB_DEVICE_PRODUCT="Dawn Tracker nRF Receiver 2"

CONFIG_USE_SEGGER_RTT=y
CONFIG_RTT_CONSOLE=y
CONFIG_LOG_BACKEND_RTT=y

CONFIG_MPSL=y
CONFIG_MPSL_FEM=y
CONFIG_MPSL_FEM_SIMPLE_GPIO=y

# Generate an image for the Adafruit nRF52 UF2 bootloader.
CONFIG_BUILD_OUTPUT_UF2=y
CONFIG_BUILD_OUTPUT_UF2_FAMILY_ID="0x621E937A"
CONFIG_FLASH_LOAD_OFFSET=0x1000
CONFIG_RADIO_TX_POWER=30
```

## boards/estenova/estenova_r1/Kconfig.estenova_r1_uf2
```kconfig
# Copyright (c) 2018 Nordic Semiconductor ASA
# SPDX-License-Identifier: Apache-2.0

config BOARD_ESTENOVA_R1_UF2
	select SOC_NRF52840_QIAA

if BOARD_ESTENOVA_R1_UF2

config BOARD_SERIAL_BACKEND_CDC_ACM
	bool "USB CDC"
	default y

config BOARD_ENABLE_DCDC
    bool "DCDC mode"
    select SOC_DCDC_NRF52X
    default n

endif # BOARD_ESTENOVA_R1_UF2
```

## boards/estenova/estenova_r1/board.yml
```yaml
# Copyright (c) 2024 Nordic Semiconductor ASA
# SPDX-License-Identifier: Apache-2.0

board:
  name: estenova_r1_uf2
  full_name: Estenova R1
  vendor: estenova
  socs:
    - name: nrf52840
```

## boards/foxapplication/foxdongle33_uf2/Kconfig.foxdongle33_uf2
```kconfig
# Copyright (c) 2024 Nordic Semiconductor ASA
# SPDX-License-Identifier: Apache-2.0

config BOARD_FOXDONGLE33_UF2
	select SOC_NRF52833_QIAA

if BOARD_FOXDONGLE33_UF2

config BOARD_SERIAL_BACKEND_CDC_ACM
	bool "USB CDC"
	default y

endif # BOARD_FOXDONGLE33_UF2
```

## boards/foxapplication/foxdongleneo_uf2/board.yml
```yaml
# Copyright (c) 2024 Nordic Semiconductor ASA
# SPDX-License-Identifier: Apache-2.0

board:
  name: foxdongleneo_uf2
  full_name: FoxApplication Receiver FoxDongleNEO
  vendor: foxapplication
  socs:
    - name: nrf52840
```

## boards/foxapplication/foxdongleneo_uf2/foxdongleneo_uf2_nrf52840_defconfig
```kconfig
# Copyright (c) 2024 Nordic Semiconductor ASA
# SPDX-License-Identifier: Apache-2.0

CONFIG_ARM_MPU=y
CONFIG_HW_STACK_PROTECTION=y
CONFIG_GPIO=y
CONFIG_PWM=y
CONFIG_LED_RGB_COLOR=y

CONFIG_SLIMEVR_USB_DEVICE_MANUFACTURER="FoxApplication"
CONFIG_SLIMEVR_USB_DEVICE_PRODUCT="FoxApplication Receiver FoxDongleNEO"

CONFIG_USE_SEGGER_RTT=y
CONFIG_RTT_CONSOLE=y
CONFIG_LOG_BACKEND_RTT=y

CONFIG_MPSL=y
CONFIG_MPSL_FEM=y
CONFIG_MPSL_FEM_SIMPLE_GPIO=y
CONFIG_RADIO_TX_POWER=30

# Generate an image for the Adafruit nRF52 UF2 bootloader.
CONFIG_BUILD_OUTPUT_UF2=y
CONFIG_BUILD_OUTPUT_UF2_FAMILY_ID="0xada52840"
```

## boards/foxapplication/foxpromicro_rfek_uf2/Kconfig.foxpromicro_rfek_uf2
```kconfig
# Copyright (c) 2024 Nordic Semiconductor ASA
# SPDX-License-Identifier: Apache-2.0

config BOARD_FOXPROMICRO_RFEK_UF2
	select SOC_NRF52840_QIAA

if BOARD_FOXPROMICRO_RFEK_UF2

config BOARD_SERIAL_BACKEND_CDC_ACM
	bool "USB CDC"
	default y

endif # BOARD_FOXPROMICRO_RFEK_UF2
```

## boards/hulimiao/nekonya/Kconfig.nekonya_uf2
```kconfig
# Copyright (c) 2024 Nordic Semiconductor ASA
# SPDX-License-Identifier: Apache-2.0

config BOARD_NEKONYA_UF2
	select SOC_NRF52833_QDAA

if BOARD_NEKONYA_UF2

config BOARD_SERIAL_BACKEND_CDC_ACM
	bool "USB CDC"
	default y

endif # BOARD_NEKONYA_UF2
```
